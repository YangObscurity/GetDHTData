## components/dht_sensor/Kconfig
```kconfig
menu "DHT_GPIO"
    config DHT_GPIO
        int "specify DHT11 pin"
        help
            DEFINE THE SPECIFIED PIN WHICH 
            YOU CONNECTED TO DHT11 SENSOR
endmenu
```

## components/http_build/Kconfig
```kconfig
menu "HTTP Setting"
    config HTTP_SERVER_URL
        string "SERVER_URL"
        help
            MUST INPUT YOUR SERVER_URL
endmenu
```

## components/network/Kconfig
```kconfig
menu "NETWORK_CFG"
    config NETWORK_SSID
        string "SSID"
        help
            ENTER YOUR HOST WIFI SSID TO CONNECT
    config NETWORK_PASSWORD
        string "PASSWORD"
        help 
            ENTER YOUR HOST WIFI PASSWORD TO CONNECT
endmenu
```

## main/Kconfig
```kconfig
menu "ESP_MAIN_SETTING"
    config ESP_DEBUG_LOGV
        bool "SHOW THE INFORMATION OF DEBUG"
        default y
        help
            OPEN THIS WILL SHOW DEBUG INFORMATION(verbose mode)
    config ESP_DEVICE_ID
        string "DEVICE ID"
        default "ESP32_1"
        help
            ALLOCATE THE DEVICE ID OF ESP32
endmenu
```
